## config/boards/shields/mEnki42/Kconfig.defconfig
```kconfig
# Copyright (c) 2020 The ZMK Contributors
# SPDX-License-Identifier: MIT

if SHIELD_MENKI42_DONGLE

config ZMK_KEYBOARD_NAME
	default "mEnki42"

config ZMK_SPLIT_ROLE_CENTRAL
	default y

endif


if SHIELD_MENKI42_DONGLE || SHIELD_MENKI42_KBD

config ZMK_SPLIT
	default y


endif
```

## config/boards/shields/mEnki42/Kconfig.shield
```kconfig
# Copyright (c) 2020 The ZMK Contributors
# SPDX-License-Identifier: MIT

config SHIELD_MENKI42
	def_bool $(shields_list_contains,mEnki42)
```
